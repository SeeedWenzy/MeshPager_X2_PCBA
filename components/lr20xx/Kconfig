## components/lr20xx/Kconfig
```kconfig
menu "Radio LR20XX"
    menu "GPIO Config"
        config RADIO_SPI_HOST
            int "Radio LR20XX spi host value"
            default 1
            range 0 3
        config RADIO_CS_GPIO
            int "Radio LR20XX spi cs pin"
            default 0
        config RADIO_SCK_GPIO
            int "Radio LR20XX spi sck pin"
            default 3
        config RADIO_MOSI_GPIO
            int "Radio LR20XX spi mosi pin"
            default 4
        config RADIO_MISO_GPIO
            int "Radio LR20XX spi miso pin"
            default 5
        config RADIO_BUSY_GPIO
            int "Radio LR20XX busy pin"
            default 8
        config RADIO_INT_GPIO
            int "Radio LR20XX interrupt pin"
            default 7
        config RADIO_RST_GPIO
            int "Radio LR20XX reset pin"
            default 10
    endmenu
    menu "IO Expander Config"
        config RADIO_IO_EXPANDER_ENABLE
            bool "Enable IO expander for Radio LR20XX"
            default n
        if RADIO_IO_EXPANDER_ENABLE
            config RADIO_IO_EXPANDER_TYPE
                string "IO expander type for Radio LR20XX"
                default "tca6424"
        config RADIO_IO_EXPANDER_RST_GPIO
            int "Radio LR20XX IO expander reset pin"
            default 22   
        endif
    endmenu
endmenu
```

## components/meshpager_x2/Kconfig
```kconfig
menu "Board Support Package(ESP32-S3)"

    config BSP_ERROR_CHECK
        bool "Enable error check in BSP"
        default y
        help
            Error check assert the application before returning the error code.

    menu "uSD card - Virtual File System"
        config BSP_SD_FORMAT_ON_MOUNT_FAIL
            bool "Format uSD card if mounting fails"
            default n
            help
                The SDMMC host will format (FAT) the uSD card if it fails to mount the filesystem.

        config BSP_SD_MOUNT_POINT
            string "uSD card mount point"
            default "/sdcard"
            help
                Mount point of the uSD card in the Virtual File System

    endmenu

    menu "SPIFFS - Virtual File System"
        config BSP_SPIFFS_FORMAT_ON_MOUNT_FAIL
            bool "Format SPIFFS if mounting fails"
            default n
            help
                Format SPIFFS if it fails to mount the filesystem.

        config BSP_SPIFFS_MOUNT_POINT
            string "SPIFFS mount point"
            default "/spiffs"
            help
                Mount point of SPIFFS in the Virtual File System.

        config BSP_SPIFFS_PARTITION_LABEL
            string "Partition label of SPIFFS"
            default "storage"
            help
                Partition label which stores SPIFFS.

        config BSP_SPIFFS_MAX_FILES
            int "Max files supported for SPIFFS VFS"
            default 5
            help
                Supported max files for SPIFFS in the Virtual File System.
    endmenu
    
endmenu
```

## examples/test_fullfeatured/main/Kconfig.projbuild
```kconfig
menu "Full-Featured Runner"

config RUNNER_MIN_PERIOD_MS
    int "Minimum job period (ms)"
    default 100
    range 100 3600000
    help
        Floor enforced by the `period_set` console command.

config RUNNER_PERIOD_DISPLAY_MS
    int "Display (LCD) job period (ms)"
    default 10000

config RUNNER_PERIOD_AUDIO_MS
    int "Audio (play/record) job period (ms)"
    default 5000

config RUNNER_PERIOD_WIFI_MS
    int "Wi-Fi AP job period (ms)"
    default 20000

config RUNNER_PERIOD_BLE_MS
    int "BLE advertising job period (ms)"
    default 10000

config RUNNER_PERIOD_GNSS_MS
    int "GNSS NMEA job period (ms)"
    default 5000

config RUNNER_PERIOD_SENSOR_MS
    int "Sensor (RTC/SHT4X/BMM350) job period (ms)"
    default 2000

config RUNNER_PERIOD_IMU_MS
    int "IMU (LSM6DSOX accel/gyro) job period (ms)"
    default 2000

config RUNNER_PERIOD_LORA_TX_MS
    int "LoRa TX job period (ms)"
    default 3000

config RUNNER_PERIOD_LORA_RX_MS
    int "LoRa RX job period (ms)"
    default 5000

config RUNNER_PERIOD_SDCARD_MS
    int "SD card r/w job period (ms)"
    default 10000

config RUNNER_PERIOD_BATTERY_MS
    int "Battery ADC job period (ms)"
    default 5000

config RUNNER_LORA_RX_ENABLED_BY_DEFAULT
    bool "LoRa RX job enabled at boot"
    default y
    help
        LoRa TX and RX share one radio and serialize via a mutex, so both
        may be enabled at the same time. Disable if you only want TX.

endmenu
```

## examples/test_wireless_coexistence/sdkconfig.defaults
```kconfig
# ESP32-S3 wireless coexistence test
CONFIG_IDF_TARGET="esp32s3"
CONFIG_ESPTOOLPY_FLASHSIZE_16MB=y
CONFIG_PARTITION_TABLE_CUSTOM=y
CONFIG_SPIRAM=y
CONFIG_SPIRAM_MODE_OCT=y
CONFIG_SPIRAM_SPEED_80M=y
CONFIG_SPIRAM_MALLOC_ALWAYSINTERNAL=1024
CONFIG_SPIRAM_MALLOC_RESERVE_INTERNAL=262144
CONFIG_ESP_DEFAULT_CPU_FREQ_MHZ_240=y
CONFIG_ESP_DEFAULT_CPU_FREQ_MHZ=240

CONFIG_ESP_CONSOLE_USB_SERIAL_JTAG=y
CONFIG_ESP_CONSOLE_SECONDARY_NONE=y

CONFIG_BT_ENABLED=y
CONFIG_BTDM_CTRL_MODE_BLE_ONLY=y
CONFIG_BTDM_CTRL_MODE_BR_EDR_ONLY=n
CONFIG_BTDM_CTRL_MODE_BTDM=n
CONFIG_BT_BLUEDROID_ENABLED=n
CONFIG_BT_NIMBLE_ENABLED=y

CONFIG_ESPTOOLPY_FLASHMODE_QIO=y
CONFIG_ESPTOOLPY_FLASHFREQ_80M=y

CONFIG_ESP_WIFI_STATIC_RX_BUFFER_NUM=16
CONFIG_ESP_WIFI_DYNAMIC_RX_BUFFER_NUM=64
CONFIG_ESP_WIFI_DYNAMIC_TX_BUFFER_NUM=64
CONFIG_ESP_WIFI_AMPDU_TX_ENABLED=y
CONFIG_ESP_WIFI_TX_BA_WIN=32
CONFIG_ESP_WIFI_AMPDU_RX_ENABLED=y
CONFIG_ESP_WIFI_RX_BA_WIN=32

CONFIG_LWIP_TCP_SND_BUF_DEFAULT=65535
CONFIG_LWIP_TCP_WND_DEFAULT=65535
CONFIG_LWIP_UDP_RECVMBOX_SIZE=64
CONFIG_LWIP_TCPIP_RECVMBOX_SIZE=64
CONFIG_IPERF_SOCKET_RX_TIMEOUT=10
CONFIG_IPERF_SOCKET_TCP_TX_TIMEOUT=10
CONFIG_IPERF_TRAFFIC_TASK_PRIORITY=4
CONFIG_IPERF_REPORT_TASK_PRIORITY=6
CONFIG_IPERF_DEF_TCP_TX_BUFFER_LEN=16384
CONFIG_IPERF_DEF_TCP_RX_BUFFER_LEN=16384
CONFIG_IPERF_DEF_IPV4_UDP_TX_BUFFER_LEN=1470
CONFIG_IPERF_DEF_IPV6_UDP_TX_BUFFER_LEN=1450
CONFIG_IPERF_DEF_UDP_RX_BUFFER_LEN=16384

CONFIG_RADIO_SPI_HOST=1
CONFIG_RADIO_CS_GPIO=6
CONFIG_RADIO_SCK_GPIO=3
CONFIG_RADIO_MOSI_GPIO=4
CONFIG_RADIO_MISO_GPIO=5
CONFIG_RADIO_BUSY_GPIO=8
CONFIG_RADIO_INT_GPIO=7
CONFIG_RADIO_RST_GPIO=10
```
